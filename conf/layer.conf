## conf/layer.conf
```bitbake
# We have a conf and classes directory, add to BBPATH
BBPATH .= ":${LAYERDIR}"

# We have recipes-* directories, add to BBFILES
BBFILES += "${LAYERDIR}/recipes-*/*/*.bb \
            ${LAYERDIR}/recipes-*/*/*.bbappend"

BBFILE_COLLECTIONS += "meta-qfom"
BBFILE_PATTERN_meta-qfom = "^${LAYERDIR}/"
BBFILE_PRIORITY_meta-qfom = "10"

LAYERDEPENDS_meta-qfom = "core"
LAYERSERIES_COMPAT_meta-qfom = "scarthgap"

#IMAGE_INSTALL += "ninja minicom libgpiod libgpiod-tools htop nano tree packagegroup-core-buildessential cmake"
#EXTRA_IMAGE_FEATURES += "dev-pkgs"
#
# EXTRA_IMAGE_FEATURES:append = " dev-pkgs"
# IMAGE_INSTALL:append = " ninja minicom libgpiod libgpiod-tools htop nano tree packagegroup-core-buildessential cmake"
```
